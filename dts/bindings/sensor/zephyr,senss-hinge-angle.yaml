## dts/bindings/sensor/zephyr,senss-hinge-angle.yaml
```yaml
# Copyright (c) 2023, Intel Corporation
# SPDX-License-Identifier: Apache-2.0
#

description: Sensor subsystem (senss) hinge angle sensor bindings.

compatible: "zephyr,senss-hinge-angle"

# Common senss sensor properties.
include: ["zephyr,senss-sensor.yaml"]
```

## dts/bindings/sensor/zephyr,senss-phy-3d-sensor.yaml
```yaml
# Copyright (c) 2023, Intel Corporation
# SPDX-License-Identifier: Apache-2.0
#

description: Sensor subsystem (senss) physical 3d sensors(accel, gyro, mag) bindings.

compatible: "zephyr,senss-phy-3d-sensor"

include: zephyr,senss-phy-sensor.yaml
```

## dts/bindings/sensor/zephyr,senss-phy-sensor.yaml
```yaml
# Copyright (c) 2023, Intel Corporation
# SPDX-License-Identifier: Apache-2.0
#

description: Sensor subsystem (senss) physical sensor properties bindings.

include: zephyr,senss-sensor.yaml

properties:
  underlying-device:
    type: phandle
    required: true
    description: underlying sensor device for physical sensor
```

## dts/bindings/sensor/zephyr,senss-sensor.yaml
```yaml
# Copyright (c) 2023, Intel Corporation
# SPDX-License-Identifier: Apache-2.0
#

description: Sensor subsystem (senss) sensor common properties bindings.

include: sensor-device.yaml

properties:
  sensor-type:
    type: int
    required: true
    description: sensor type id (follow HID spec definition)

  sensor-index:
    type: int
    required: true
    description: sensor instance index for same sensor type

  friendly-name:
    required: true

  minimal-interval:
    type: int
    required: true
    description: sensor minimal report interval

  rotation-matrix:
    type: array
    description: sensor rotation matrix

  reporters:
    type: phandles
    description: sensor reporters
```

## dts/bindings/sensor/zephyr,senss.yaml
```yaml
# Copyright (c) 2023, Intel Corporation
# SPDX-License-Identifier: Apache-2.0
#

description: Sensor Subsystem (senss)

compatible: "zephyr,senss"

# To add senss related common feature
```

## samples/subsys/senss/simple/sample.yaml
```yaml
sample:
  description: A sensor framework sample
  name: senss sample
common:
  tags: senss
  integration_platforms:
    - native_posix
  harness: console
  harness_config:
    type: multi_line
    regex:
      - "senss run successfully"
tests:
  sample.subsys.senss.simple:
    platform_allow: native_posix
    tags: senss
```

## subsys/senss/Kconfig
```kconfig
# Copyright (c) 2023 Intel Corporation
# SPDX-License-Identifier: Apache-2.0

config SENSS
	bool "Sensor Subsystem"
	default y
	depends on DT_HAS_ZEPHYR_SENSS_ENABLED
	select RING_BUFFER
	help
	  Enable Sensor Subsystem.

if SENSS

module = SENSS
module-str = senss
source "subsys/logging/Kconfig.template.log_config"

config SENSS_MAX_SENSOR_COUNT
	int "maximum sensor count for senss"
	depends on SENSS
	default 128
	help
	  This is the maximum sensor count supported for senss
	  Typical values are 128

config SENSS_MAX_REPORTER_COUNT
	int "maximum reporters count for an client sensor"
	depends on SENSS
	default 10
	help
	  This is the maximum sensor reporeters count supported for a sensor
	  Typical values are 10

config SENSS_MAX_SENSITIVITY_COUNT
	int "maximum sensitivity count one sensor could support"
	depends on SENSS
	default 6
	help
	  This is the maximum sensitivity count one sensor could support
	  Typical values are 6

config SENSS_MAX_CONNECTION_COUNT
	int "maximum connection count"
	depends on SENSS
	default 256
	help
	  This is the maximum connection count senss could support
	  when sensor is opened by applcaiton, senss_open_sensor()
	  is called, connection count will be accumulated.
	  Typical values are 256

source "subsys/senss/sensor/phy_3d_sensor/Kconfig"
source "subsys/senss/sensor/hinge_angle/Kconfig"

endif # SENSS
```

## subsys/senss/sensor/hinge_angle/Kconfig
```kconfig
# Copyright (c) 2023 Intel Corporation
# SPDX-License-Identifier: Apache-2.0

config  SENSS_SENSOR_HINGE_ANGLE
	bool "Senss hinge angle sensor"
	depends on DT_HAS_ZEPHYR_SENSS_HINGE_ANGLE_ENABLED
	default y
	help
	  Enable senss hingle angle sensor.
```

## subsys/senss/sensor/phy_3d_sensor/Kconfig
```kconfig
# Copyright (c) 2023 Intel Corporation
# SPDX-License-Identifier: Apache-2.0

config SENSS_SENSOR_PHY_3D_SENSOR
	bool "Senss physical 3d sensors(accel, gyro, mag)"
	default y
	depends on DT_HAS_ZEPHYR_SENSS_PHY_3D_SENSOR_ENABLED
	help
	  Enable senss physical 3d sensors(accel, gyro, mag).
```
